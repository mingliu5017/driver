## codec/AD82584F/Kconfig
```kconfig
menuconfig AMLOGIC_SND_SOC_CODECS
	bool "AMLOGIC CODEC drivers"
	default n
	help
	  Say Y or M if you want to add support for codecs attached to
	  the Amlogic Asoc interface. You will also need
	  to select the audio interfaces to support below.

#if AMLOGIC_SND_SOC_CODECS

config AMLOGIC_SND_SOC_AD82584F
		bool "ESMT AD82584F"
		depends on AMLOGIC_SND_SOC_CODECS
		depends on I2C
		default n
		help
		Enable Support for ESMT AD82584f CODEC.
		Select this if your AD82584F is connected via an I2C bus.

#endif #AMLOGIC_SND_SOC_CODECS
```

## codec/AD83586B/Kconfig
```kconfig
menuconfig AMLOGIC_SND_SOC_CODECS
	bool "AMLOGIC CODEC drivers"
	default n
	help
	  Say Y or M if you want to add support for codecs attached to
	  the Amlogic Asoc interface. You will also need
	  to select the audio interfaces to support below.

#if AMLOGIC_SND_SOC_CODECS

config AMLOGIC_SND_SOC_AD83586B
		bool "ESMT AD83586B"
		depends on AMLOGIC_SND_SOC_CODECS
		depends on I2C
		default n
		help
		Enable Support for ESMT AD83586B CODEC.
		Select this if your AD83586B is connected via an I2C bus.

#endif #AMLOGIC_SND_SOC_CODECS
```

## codec/AD85050/Kconfig
```kconfig
menuconfig AMLOGIC_SND_SOC_CODECS
	bool "AMLOGIC CODEC drivers"
	default n
	help
	  Say Y or M if you want to add support for codecs attached to
	  the Amlogic Asoc interface. You will also need
	  to select the audio interfaces to support below.

#if AMLOGIC_SND_SOC_CODECS

config AMLOGIC_SND_SOC_AD85050
		bool "ESMT AD85050"
		depends on AMLOGIC_SND_SOC_CODECS
		depends on I2C
		default n
		help
		Enable Support for ESMT AD85050 CODEC.
		Select this if your AD85050 is connected via an I2C bus.

#endif #AMLOGIC_SND_SOC_CODECS
```

## codec/TAS5766m/Kconfig
```kconfig
menuconfig AMLOGIC_SND_SOC_CODECS
	bool "AMLOGIC CODEC drivers"
	default n
	help
	  Say Y or M if you want to add support for codecs attached to
	  the Amlogic Asoc interface. You will also need
	  to select the audio interfaces to support below.

#if AMLOGIC_SND_SOC_CODECS

#Third part codecs
# Amlogic add codecs
config AMLOGIC_SND_SOC_TAS5766M
	bool "Texas Instruments TAS5766m"
	depends on AMLOGIC_SND_SOC_CODECS
	depends on I2C
	default n
	help
		Enable Support for Texas INstruments TAS5766m CODEC.
		Select this if your TAS5766m is connected via an I2C bus.

#endif #AMLOGIC_SND_SOC_CODECS
```

## codec/du161/Kconfig
```kconfig
menuconfig AMLOGIC_SND_SOC_CODECS
	bool "AMLOGIC CODEC drivers"
	default n
	help
	  Say Y or M if you want to add support for codecs attached to
	  the Amlogic Asoc interface. You will also need
	  to select the audio interfaces to support below.

#if AMLOGIC_SND_SOC_CODECS

config AMLOGIC_SND_SOC_DU161
	bool "MVSILICON DU161"
	depends on AMLOGIC_SND_SOC_CODECS
	depends on I2C
	default n
	help
		Enable Support for MVSILICON DU161 CODEC.

#endif #AMLOGIC_SND_SOC_CODECS
```

## codec/es7243/Kconfig
```kconfig
menuconfig AMLOGIC_SND_SOC_CODECS
	bool "AMLOGIC CODEC drivers"
	default n
	help
	  Say Y or M if you want to add support for codecs attached to
	  the Amlogic Asoc interface. You will also need
	  to select the audio interfaces to support below.

#if AMLOGIC_SND_SOC_CODECS

config AMLOGIC_SND_SOC_ES7243
	bool "EVEREST SEMI ES7243"
	depends on AMLOGIC_SND_SOC_CODECS
	depends on I2C
	default n
	help
		Enable Support for EVEREST SEMI ES7243 CODEC.
		Select this if your ES7243 is connected via an I2C bus.
		Enable Support for EVEREST SEMI ES7243 CODEC.
		Select this if your ES7243 is connected via an I2C bus.

#endif #AMLOGIC_SND_SOC_CODECS
```

## codec/ntp8810/Kconfig
```kconfig
menuconfig AMLOGIC_SND_SOC_CODECS
	bool "AMLOGIC CODEC drivers"
	default n
	help
	  Say Y or M if you want to add support for codecs attached to
	  the Amlogic Asoc interface. You will also need
	  to select the audio interfaces to support below.

#if AMLOGIC_SND_SOC_CODECS

config AMLOGIC_SND_SOC_NTP8810
		bool "NTP8810"
		depends on AMLOGIC_SND_SOC_CODECS
		depends on I2C
		default n
		help
		Enable Support for NTP8810 CODEC.
		Select this if your NTP8810 is connected via an I2C bus.

#endif #AMLOGIC_SND_SOC_CODECS
```

## codec/tfa9894_6_5_3/Kconfig
```kconfig
menuconfig NXP_SND_SOC_CODECS
	bool "NXP CODEC drivers"
	default n
	help
	  Say Y or M if you want to add support for codecs attached to
	  the NXP Asoc interface. You will also need
	  to select the audio interfaces to support below.

#if NXP_SND_SOC_CODECS

config NXP_SND_CODEC_TFA98XX
	tristate "NXP Audio tfa 98xx codec"
	depends on NXP_SND_SOC_CODECS
	default n
	help
		NXP Audio codec,
		tfa 98xx codec,
		this codec is internal

#endif #NXP_SND_SOC_CODECS
```

## display/aw95xx/Kconfig
```kconfig
#
# LEDRING drivers configuration
#
config AMLOGIC_AW9523B
	bool "System AW9523B Support"
	default n
	help
	  This option enables support for system AW9523B drivers.
```

## display/lcd/Kconfig
```kconfig
#
# LEDRING drivers configuration
#
config AMLOGIC_LCD
	bool "System LCD HSG12864 Support"
	default n
	help
	  This option enables support for system LCD HSG12864 drivers.
```

## display/pl50xx/Kconfig
```kconfig
#
# LEDRING drivers configuration
#
config AMLOGIC_LP50XX
	bool "System lp50xx Support"
	default n
	help
	  This option enables support for system lp50xx drivers.
```

## display/pwm_led/Kconfig
```kconfig
config LEDS_GPIO_REGISTER
	bool
	help
	  This option provides the function gpio_led_register_device.
	  As this function is used by arch code it must not be compiled as a
	  module.

menuconfig NEW_LEDS
	bool "LED Support"
	help
	  Say Y to enable Linux LED support.  This allows control of supported
	  LEDs from both userspace and optionally, by kernel events (triggers).

if NEW_LEDS

config LEDS_CLASS
	tristate "LED Class Support"
	help
	  This option enables the led sysfs class in /sys/class/leds.  You'll
	  need this to do anything useful with LEDs.  If unsure, say N.

config LEDS_CLASS_FLASH
	tristate "LED Flash Class Support"
	depends on LEDS_CLASS
	help
	  This option enables the flash led sysfs class in /sys/class/leds.
	  It wrapps LED Class and adds flash LEDs specific sysfs attributes
	  and kernel internal API to it. You'll need this to provide support
	  for the flash related features of a LED device. It can be built
	  as a module.

comment "LED drivers"

config LEDS_PWM
	tristate "PWM driven LED Support"
	depends on LEDS_CLASS
	depends on PWM
	help
	  This option enables support for pwm driven LEDs


comment "LED Triggers"
source "drivers/leds/trigger/Kconfig"

endif # NEW_LEDS
```

## input/i2c_key/Kconfig
```kconfig
#
# Kyeboard device configuration
#

menuconfig AMLOGIC_INPUT_KEYBOARD
	bool "Keyboards and keypads"
	default n
	help
	  Say Y here, and a list of supported keyboards and keypads will be displayed.
	  This option doesn't affect the kernel.

	  If unsure, say Y.

if AMLOGIC_INPUT_KEYBOARD

config AMLOGIC_TOUCH_KEY
        tristate "Amlogic touch key device surport"
        default n
        help
          Say Y here if you want to use the amlogic touch key.

endif # AMLOGIC_INPUT_KEYBOARD
```

## input/matrix_key/Kconfig
```kconfig
#
# Kyeboard device configuration
#

menuconfig AMLOGIC_INPUT_KEYBOARD
	bool "Keyboards and keypads"
	default n
	help
	  Say Y here, and a list of supported keyboards and keypads will be displayed.
	  This option doesn't affect the kernel.

	  If unsure, say Y.

if AMLOGIC_INPUT_KEYBOARD

config AMLOGIC_MATRIX_KEY
        tristate "Amlogic matrix key device surport"
        default n
        help
          Say Y here if you want to use the amlogic matrix key.

endif # AMLOGIC_INPUT_KEYBOARD
```

## power/Kconfig
```kconfig
config AMLOGIC_POWER
	bool "Amloigc power related driver support"
	default n
	help
		this config enables to use amlogic power management driver
		Say y here if you want power related driver(pmu/dvfs) support

config AMLOGIC_PMU_OF
	bool "Amlogic Power OF support"
	depends on AMLOGIC_POWER
	depends on I2C
	default n
	help
		Power management device tree support

config BATTERY_CW2015
	tristate "CW2105 battery driver"
	default y
	help
	  Say Y here to enable support for batteries with CW2105 chip
	  connected over an I2C bus.

source "drivers/amlogic/power/aml_pmu/Kconfig"
source "drivers/amlogic/power/aml_dvfs/Kconfig"
```
